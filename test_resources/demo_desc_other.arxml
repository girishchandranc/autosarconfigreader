AUTOSAR XML (schema 00049)
package /ModuleConfig
  module config demo_other
    ContA_conf (contA): boolParam=1, enumParam=RED
    ContB_conf (contB)
      subCont_conf (subCont): intParam=255, ref1=ContA_conf, foreignRef=ComponentA
