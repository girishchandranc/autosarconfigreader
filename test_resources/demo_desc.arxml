AUTOSAR XML (schema 00049)
package /ModuleConfig
  module config demo
    ContA_conf (contA): boolParam=1, enumParam=RED
    ContB_conf_0 (contB)
      subCont_conf (subCont): intParam=255, ref1=ContA_conf, foreignRef=ComponentA
    ContB_conf_1 (contB)
      subCont_conf (subCont): intParam=255, ref1=ContA_conf, foreignRef=ComponentA
