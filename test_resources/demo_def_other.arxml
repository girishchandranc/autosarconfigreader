AUTOSAR XML (schema 00049)
package /ModuleDef
  module definition demo_other [0..1]: post-build-variant-support=true, variants post-build/pre-compile  # Configuration of the demo_other module.
    container contA
      boolean boolParam: default-value=false
      enumeration enumParam: {RED, YELLOW, GREEN}, default-value=GREEN
    container contB [0..*]
      container subCont [0..*]
        integer intParam: 0..65535
        reference ref1: destination=contA
        foreign reference foreignRef: destination-type=SW-COMPONENT-PROTOTYPE
