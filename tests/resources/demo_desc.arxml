AUTOSAR XML (schema 00049)
package /ModuleConfig
  module config demo
    ContA_conf (contA): boolParam=1, enumParam=RED
    ContB_conf_0 (contB)
      subCont_conf (subCont): intParam=255, ref1=ContA_conf, ref2=ContC_conf_0, ref2=ContC_conf_1, foreignRef=ComponentA
    ContB_conf_1 (contB)
      subCont_conf (subCont): intParam=1024, ref1=ContA_conf, foreignRef=ComponentA
    ContC_conf_0 (contC)
